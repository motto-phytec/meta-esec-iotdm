## conf/distro/yogurt-vendor-connagtive.conf
```bitbake
require conf/distro/yogurt-vendor.conf

DISTRO = "yogurt-vendor-connagtive"
DISTRO_NAME = "Yogurt Vendor (Phytec Vendor Distribution + Connagtive IoT Suite)"

#add protection shield level
#shieldlow - shieldmedium - shieldhigh
DISTRO_FEATURES += "protectionshield"
PROTECTION_SHIELD_LEVEL = "shieldhigh"
```
